## examples/esp-idf/05_sdcard_rw/sdkconfig.defaults
```kconfig
# SPDX-FileCopyrightText: 2026 Waveshare Electronics
#
# SPDX-License-Identifier: Apache-2.0

# Build this example for ESP32-C5 by default.
CONFIG_IDF_TARGET="esp32c5"
CONFIG_IDF_TARGET_ESP32C5=y
CONFIG_ESPTOOLPY_FLASH_SAMPLE_MODE_STR=y
CONFIG_ESPTOOLPY_FLASHMODE="dio"
CONFIG_ESPTOOLPY_FLASHFREQ_80M=y
CONFIG_ESPTOOLPY_FLASHFREQ="80m"
CONFIG_ESPTOOLPY_FLASHSIZE_4MB=y
CONFIG_ESPTOOLPY_FLASHSIZE="4MB"
CONFIG_PARTITION_TABLE_SINGLE_APP_LARGE=y
CONFIG_FATFS_LFN_HEAP=y

CONFIG_LV_FONT_MONTSERRAT_20=y
```
